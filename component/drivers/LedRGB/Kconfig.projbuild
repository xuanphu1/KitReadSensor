## component/drivers/LedRGB/Kconfig.projbuild
```kconfig
menu "LED RGB Config"
    config ACTIVE_LED_RGB
        bool "Active LED RGB"
        default y if IDF_TARGET_ESP32C6
        default n
        help 
            Enable LED RGB functionality.
            Automatically enabled for ESP32-C6, disabled for other targets.

    config LED_RGB_GPIO
        int "LED RGB GPIO Pin"
        default 8
        help
            GPIO pin number for LED RGB (WS2812). 
            For ESP32-C6, commonly used pins: 8, 9, 10, etc.
endmenu
```

## component/drivers/i2cdev/Kconfig.projbuild
```kconfig
menu "I2C common config"
    # I2C: ESP32 = SDA 21, SCL 22 | ESP32-C6 = SDA 6, SCL 7
    config I2CDEV_COMMON_SDA
        int "I2C SDA GPIO"
        default 21 if IDF_TARGET_ESP32
        default 6 if IDF_TARGET_ESP32C6
        help
            SDA GPIO for the I2C interface.

    config I2CDEV_COMMON_SCL
        int "I2C SCL GPIO"
        default 22 if IDF_TARGET_ESP32
        default 7 if IDF_TARGET_ESP32C6
        help
            SCL GPIO for the I2C interface.

    config I2CDEV_COMMON_PORT
        int "I2C PORT"
        default 0
        help    
            Select Port I2C 

    config I2CDEV_COMMON_CLK_HZ
        int "I2C CLK SPEED (Hz)"
        default 400000
        help 
            Select speed for i2c bus

    config I2CDEV_TIMEOUT
        int "I2C dev mutex timeout (ms)"
        default 1000
        help
            Timeout chờ mutex của I2CDev (đơn vị mili-giây).

    config I2CDEV_NOLOCK
        bool "Disable I2Cdev locking (no mutex)"
        default n
        help
            Nếu bật, thư viện I2CDev sẽ bỏ qua mutex (không khóa).

endmenu
```

## component/network/WifiManager/Kconfig.projbuild
```kconfig
menu "Manager Wifi Project"

    config WIFI_SSID
        string "WiFi SSID"
        default "Unknown"
        help
            SSID (network name) for the example to connect to.

    config WIFI_PASS
        string "WiFi Password"
        default "12345789"
        help
            WiFi password (WPA or WPA2) for the example to use.

    config MAX_RETRY
        int "Maximum retry"
        default 5
        help
            Set the Maximum retry to avoid station reconnecting to the AP unlimited when the AP is really inexistent.

    config AP_SSID
        string "AP SSID"
        default "ESP32_Config"
        help
            SSID for the ESP32 access point when WiFi connection fails.

    config AP_PASSWORD
        string "AP Password (Not used - AP is open)"
        default ""
        help
            Password for the ESP32 access point (currently not used as AP is configured as open).

    config AP_CHANNEL
        int "AP Channel"
        default 1
        range 1 13
        help
            WiFi channel for the ESP32 access point.

endmenu
```

## component/ui/ButtonManager/Kconfig.projbuild
```kconfig
# Một chân ADC (thang điện trở) → UP / SELECT / BACK. Không có BTN_DOWN trừ khi bổ sung khoảng/menu.
menu "Button Manager"

    config BUTTON_ANALOG_GPIO
        int "GPIO đọc analog (nút)"
        default 4 if IDF_TARGET_ESP32C6
        default 4 if IDF_TARGET_ESP32C3
        default 32 if IDF_TARGET_ESP32
        range 0 48
        help
            Chân nối thang điện trở. ESP32-C6/C3: ADC1 thường GPIO 0–6 (C6) hoặc 0–4 (C3); ESP32: GPIO 32–39 (ADC1).

    config BUTTON_ANALOG_ATTEN_DB
        int "Suy hao ADC (dB)"
        default 0
        range 0 12
        help
            Chọn 0, 2, 6 hoặc 12 (giá trị khác được làm tròn khi khởi tạo).

    config BUTTON_ANALOG_DOWN_MIN
        int "UP — ADC raw tối thiểu (gồm)"
        default 2000
        range 0 4095

    config BUTTON_ANALOG_DOWN_MAX
        int "UP — ADC raw tối đa (gồm)"
        default 2300
        range 0 4095

    config BUTTON_ANALOG_SEL_MIN
        int "SELECT — ADC raw tối thiểu (gồm)"
        default 1300
        range 0 4095

    config BUTTON_ANALOG_SEL_MAX
        int "SELECT — ADC raw tối đa (gồm)"
        default 1900
        range 0 4095

    config BUTTON_ANALOG_BACK_MIN
        int "BACK — ADC raw tối thiểu (gồm)"
        default 3200
        range 0 4095

    config BUTTON_ANALOG_BACK_MAX
        int "BACK — ADC raw tối đa (gồm)"
        default 3400
        range 0 4095

endmenu
```

## main/Kconfig.projbuild
```kconfig
menu "Pin config"
    # UART 2: ESP32 = TX 17, RX 16 | ESP32-C6 = TX 5, RX 4
    config TX_UART_2
        int "TX UART 2"
        default 17 if IDF_TARGET_ESP32
        default 5 if IDF_TARGET_ESP32C6
        help
            TX for UART interface.

    config RX_UART_2
        int "RX UART 2 "
        default 16 if IDF_TARGET_ESP32
        default 4 if IDF_TARGET_ESP32C6
        help
            RX for UART interface.

    # SPI: ESP32 = MISO 19, SCK 18, MOSI 23, CS 4 | ESP32-C6 = MOSI 2, MISO 3, SCK 23, CS 22
    config MOSI_PIN
        int "MOSI PIN"
        default 23 if IDF_TARGET_ESP32
        default 11 if IDF_TARGET_ESP32C6
        help
            MOSI for SPI interface.

    config MISO_PIN
        int "MISO PIN"
        default 19 if IDF_TARGET_ESP32
        default 18 if IDF_TARGET_ESP32C6
        help
            MISO for SPI interface.

    config SCK_PIN
        int "SCK PIN"
        default 18 if IDF_TARGET_ESP32
        default 23 if IDF_TARGET_ESP32C6
        help
            SCK for SPI interface.

    config CS_PIN
        int "CS PIN"
        default 4 if IDF_TARGET_ESP32
        default 22 if IDF_TARGET_ESP32C6
        help
            CS for SPI interface.

    # IO port: ESP32 = 32, 26, 27, 35, 33 | ESP32-C6 = 0, 1, 10, 11, 18
    config IO_1_PORT_1
        int "IO 1 PORT 1"
        default 32 if IDF_TARGET_ESP32
        default 0 if IDF_TARGET_ESP32C6
        help
            IO 1 Port 1 GPIO.

    config IO_1_PORT_2
        int "IO 1 PORT 2"
        default 26 if IDF_TARGET_ESP32
        default 1 if IDF_TARGET_ESP32C6
        help
            This is trigger pin that use for the type of Pulse Sensor.

    config IO_2_PORT_2
        int "IO 2 PORT 2"
        default 27 if IDF_TARGET_ESP32
        default 10 if IDF_TARGET_ESP32C6
        help
            This is Echo pin that use for the type of Pulse Sensor.

    config IO_3_PORT_2
        int "IO 3 PORT 2"
        default 35 if IDF_TARGET_ESP32
        default 2 if IDF_TARGET_ESP32C6
        help
            Read Analog or output GPIO.

    config IO_1_PORT_3
        int "IO 1 PORT 3"
        default 33 if IDF_TARGET_ESP32
        default 3 if IDF_TARGET_ESP32C6
        help
            Read Analog or output GPIO.
endmenu
```
